# file: Bayse1.ioc
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ARM.CMSIS.5.6.0.CMSISJjCORE=true
ARM.CMSIS.5.6.0.CMSISJjDSP=Library
Mcu.Family=STM32G0
Mcu.Name=STM32G0B1K(C-E)Tx
Mcu.Package=LQFP32
NVIC.TIM1_BRK_UP_TRG_COM_IRQn=true\:0\:0\:false\:false\:true\:false\:true
NVIC.TimeBase=TIM1_BRK_UP_TRG_COM_IRQn
NVIC.TimeBaseIP=TIM1
ProjectManager.HeapSize=0x200
ProjectManager.StackSize=0x400
ProjectManager.TargetToolchain=STM32CubeIDE
RCC.AHBFreq_Value=16000000
RCC.CortexFreq_Value=16000000
RCC.EXTERNAL_CLOCK_VALUE=48000
RCC.HCLKFreq_Value=16000000
RCC.HSE_VALUE=8000000
RCC.HSI48_VALUE=48000000
RCC.HSI_VALUE=16000000
RCC.LSE_VALUE=32768
RCC.SYSCLKFreq_VALUE=16000000
RCC.USBFreq_Value=48000000
RCC.VCOOutputFreq_Value=128000000
VP_ARM.CMSIS_VS_CMSISJjCORE_5.3.0_5.6.0.Mode=CMSISJjCORE
VP_ARM.CMSIS_VS_CMSISJjDSP_1.7.0_5.6.0.Mode=CMSISJjDSP
VP_SYS_VS_DBSignals.Mode=DisableDeadBatterySignals
VP_SYS_VS_tim1.Mode=TIM1
board=custom

// file: Core/Src/main.c
/* USER CODE BEGIN Header */
/**
 ******************************************************************************
 * @file           : main.c
 * @brief          : Main program body
 ******************************************************************************
 * @attention
 *
 * <h2><center>&copy; Copyright (c) 2021 STMicroelectronics.
 * All rights reserved.</center></h2>
 *
 * This software component is licensed by ST under BSD 3-Clause license,
 * the "License"; You may not use this file except in compliance with the
 * License. You may obtain a copy of the License at:
 *                        opensource.org/licenses/BSD-3-Clause
 *
 ******************************************************************************
 */
/* USER CODE END Header */
#include "main.h"

/* USER CODE BEGIN Includes */
#include <stdio.h>
#include "arm_math.h"
/* USER CODE END Includes */

/* USER CODE BEGIN PV */
arm_gaussian_naive_bayes_instance_f32 S;

#define NB_OF_CLASSES 3
#define VECTOR_DIMENSION 2

const float32_t theta[NB_OF_CLASSES * VECTOR_DIMENSION] = { 1.4539529436590528f,
		0.8722776016801852f, -1.5267934452462473f, 0.903204577814203f,
		-0.15338006360932258f, -2.9997913665803964f }; /**< Mean values for the Gaussians */

const float32_t sigma[NB_OF_CLASSES * VECTOR_DIMENSION] = { 1.0063470889514925f,
		0.9038018246524426f, 1.0224479953244736f, 0.7768764290432544f,
		1.1217662403241206f, 1.2303890106020325f }; /**< Variances for the Gaussians */

const float32_t classPriors[NB_OF_CLASSES] = { 0.3333333333333333f,
		0.3333333333333333f, 0.3333333333333333f }; /**< Class prior probabilities */

/* USER CODE END PV */

void SystemClock_Config(void);

int main(void) {

	/* MCU Configuration--------------------------------------------------------*/

	/* Reset of all peripherals, Initializes the Flash interface and the Systick. */
	HAL_Init();

	/* Configure the system clock */
	SystemClock_Config();

	/* Initialize all configured peripherals */
	/* USER CODE BEGIN 2 */
	/* Array of input data */
	float32_t in[2];

	/* Result of the classifier */
	float32_t result[NB_OF_CLASSES];
	float32_t maxProba;
	uint32_t index;

	S.vectorDimension = VECTOR_DIMENSION;
	S.numberOfClasses = NB_OF_CLASSES;
	S.theta = theta;
	S.sigma = sigma;
	S.classPriors = classPriors;
	S.epsilon = 4.328939296523643e-09f;

	in[0] = 1.5f;
	in[1] = 1.0f;

	arm_gaussian_naive_bayes_predict_f32(&S, in, result);

	arm_max_f32(result, NB_OF_CLASSES, &maxProba, &index);

#if defined(SEMIHOSTING)
	  printf("Class = %d\n", index);
	#endif

	in[0] = -1.5f;
	in[1] = 1.0f;

	arm_gaussian_naive_bayes_predict_f32(&S, in, result);

	arm_max_f32(result, NB_OF_CLASSES, &maxProba, &index);

#if defined(SEMIHOSTING)
	  printf("Class = %d\n", index);
	#endif

	in[0] = 0.0f;
	in[1] = -3.0f;

	arm_gaussian_naive_bayes_predict_f32(&S, in, result);

	arm_max_f32(result, NB_OF_CLASSES, &maxProba, &index);

#if defined(SEMIHOSTING)
	  printf("Class = %d\n", index);
	#endif

#if !defined(SEMIHOSTING)
	while (1)
		; /* main function does not return */
#endif
	/* USER CODE END 2 */

	/* Infinite loop */
	while (1) {

	}
}

void SystemClock_Config(void) {
	RCC_OscInitTypeDef RCC_OscInitStruct = { 0 };
	RCC_ClkInitTypeDef RCC_ClkInitStruct = { 0 };

	/** Configure the main internal regulator output voltage
	 */
	HAL_PWREx_ControlVoltageScaling(PWR_REGULATOR_VOLTAGE_SCALE1);
	/** Initializes the RCC Oscillators according to the specified parameters
	 * in the RCC_OscInitTypeDef structure.
	 */
	RCC_OscInitStruct.OscillatorType = RCC_OSCILLATORTYPE_HSI;
	RCC_OscInitStruct.HSIState = RCC_HSI_ON;
	RCC_OscInitStruct.HSIDiv = RCC_HSI_DIV1;
	RCC_OscInitStruct.HSICalibrationValue = RCC_HSICALIBRATION_DEFAULT;
	RCC_OscInitStruct.PLL.PLLState = RCC_PLL_NONE;
	if (HAL_RCC_OscConfig(&RCC_OscInitStruct) != HAL_OK) {
		Error_Handler();
	}
	/** Initializes the CPU, AHB and APB buses clocks
	 */
	RCC_ClkInitStruct.ClockType = RCC_CLOCKTYPE_HCLK | RCC_CLOCKTYPE_SYSCLK
			| RCC_CLOCKTYPE_PCLK1;
	RCC_ClkInitStruct.SYSCLKSource = RCC_SYSCLKSOURCE_HSI;
	RCC_ClkInitStruct.AHBCLKDivider = RCC_SYSCLK_DIV1;
	RCC_ClkInitStruct.APB1CLKDivider = RCC_HCLK_DIV1;

	if (HAL_RCC_ClockConfig(&RCC_ClkInitStruct, FLASH_LATENCY_0) != HAL_OK) {
		Error_Handler();
	}
}

void HAL_TIM_PeriodElapsedCallback(TIM_HandleTypeDef *htim) {
	if (htim->Instance == TIM1) {
		HAL_IncTick();
	}
}

void Error_Handler(void) {
	__disable_irq();
	while (1) {
	}
}

/************************ (C) COPYRIGHT STMicroelectronics *****END OF FILE****/
